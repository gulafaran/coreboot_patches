## defconfig
```kconfig
CONFIG_CCACHE=y
CONFIG_VENDOR_LENOVO=y
CONFIG_NO_POST=y
CONFIG_VGA_BIOS=y
CONFIG_CBFS_SIZE=0x400000
CONFIG_HAVE_IFD_BIN=y
CONFIG_BOARD_LENOVO_X230_FHD=y
CONFIG_PCIEXP_L1_SUB_STATE=y
CONFIG_PCIEXP_CLK_PM=y
CONFIG_VGA_BIOS_SECOND=y
CONFIG_VGA_BIOS_SECOND_ID="1002,687f"
CONFIG_VGA_BIOS_SECOND_FILE="pci1002,687f.rom"
CONFIG_FORCE_MAX_TURBO_RATIO=y
CONFIG_CPU_MICROCODE_CBFS_NONE=y
# CONFIG_RAMINIT_ENABLE_ECC is not set
CONFIG_H8_SUPPORT_BT_ON_WIFI=y
CONFIG_HAVE_ME_BIN=y
CONFIG_ME_REGION_ALLOW_CPU_READ_ACCESS=y
CONFIG_USE_ME_CLEANER=y
CONFIG_HAVE_GBE_BIN=y
CONFIG_MAINBOARD_USE_LIBGFXINIT=y
CONFIG_BOOTSPLASH=y
CONFIG_PCIEXP_HOTPLUG=y
CONFIG_PCIEXP_HOTPLUG_PREFETCH_MEM_BELOW_4G=y
CONFIG_SMMSTORE_V2=y
CONFIG_USBDEBUG=y
CONFIG_USBDEBUG_DONGLE_FTDI_FT232H=y
CONFIG_DRIVERS_PS2_KEYBOARD=y
CONFIG_TPM_DEACTIVATE=y
# CONFIG_CONSOLE_CBMEM is not set
CONFIG_DEFAULT_CONSOLE_LOGLEVEL_3=y
CONFIG_PAYLOAD_TIANOCORE=y
CONFIG_TIANOCORE_UEFIPAYLOAD=y
CONFIG_TIANOCORE_REVISION_ID="origin/uefipayloadpkg"
CONFIG_TIANOCORE_BOOTSPLASH_IMAGE=y
CONFIG_COREINFO_SECONDARY_PAYLOAD=y
CONFIG_NVRAMCUI_SECONDARY_PAYLOAD=y
CONFIG_DEBUG_RAM_SETUP=y
```
